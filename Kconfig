## Kconfig
```kconfig
config FROST_STATUS_LED
    bool "Conductor風のステータスLED(接続先ごとの色・待機中の点滅・レイヤー色)"
    depends on !ZMK_SPLIT || ZMK_SPLIT_ROLE_CENTRAL
    select GPIO

if FROST_STATUS_LED

config FROST_STATUS_LED_SLOW_BLINK_MS
    int "接続先あり・待機中の点滅(片側の時間 ms)"
    default 600

config FROST_STATUS_LED_FAST_BLINK_MS
    int "接続先なし・待機中の点滅(片側の時間 ms)"
    default 150

endif

config FROST_SCROLL_SNAP
    bool "スクロールの縦横固定"
    default y
    depends on DT_HAS_ZMK_INPUT_PROCESSOR_SCROLL_SNAP_ENABLED

config FROST_AML_GATE
    bool "マウスモードへの誤復帰防止"
    default y
    depends on DT_HAS_ZMK_INPUT_PROCESSOR_AML_GATE_ENABLED

config FROST_DRAG_LOCK
    bool "ドラッグ固定キー"
    default y
    depends on DT_HAS_ZMK_BEHAVIOR_FROST_DRAG_LOCK_ENABLED
    depends on !ZMK_SPLIT || ZMK_SPLIT_ROLE_CENTRAL

config FROST_FEATURES
    bool "DeXモード自動切替・電池残量通知"
    default y
    depends on !ZMK_SPLIT || ZMK_SPLIT_ROLE_CENTRAL
    depends on ZMK_BLE && ZMK_BATTERY_REPORTING

config FROST_DEX_PROFILES
    int "DeX(スマホ)につないでいる接続先(ビット: BT0=1, BT1=2, BT2=4, BT3=8, BT4=16)"
    default 2
    depends on FROST_FEATURES

config FROST_BLE_GUIDE
    bool "DeX(Android)版レイヤーガイドへの通知(Bluetooth)"
    default y
    depends on RAW_HID && ZMK_BLE && (!ZMK_SPLIT || ZMK_SPLIT_ROLE_CENTRAL)
```

## config/west.yml
```yaml
manifest:
  remotes:
    - name: zmkfirmware
      url-base: https://github.com/zmkfirmware
    - name: caksoylar
      url-base: https://github.com/caksoylar
    - name: sekigon-gonnoc  # PAW3222
      url-base: https://github.com/sekigon-gonnoc
    - name: cormoran
      url-base: https://github.com/cormoran
    - name: imo00o
      url-base: https://github.com/imo00o
    - name: zzeneg   # Raw HID(レイヤーガイド用)
      url-base: https://github.com/zzeneg
    - name: srwi     # レイヤー・キー押下の通知(レイヤーガイド用)
      url-base: https://github.com/srwi
  projects:
    #　- name: zmk
    #   remote: zmkfirmware
    #   revision: v0.3.0
    - name: zmk
      remote: cormoran
      revision: v0.3-branch+dya
      import: app/west.yml
    - name: zmk-driver-paw3222
      remote: sekigon-gonnoc
      revision: main
    - name: zmk-rgbled-widget
      remote: caksoylar
      revision: v0.3.0
    # DYA Studio モジュール
    - name: zmk-module-ble-management
      remote: cormoran
      revision: zmk-v0.3.0.0
    - name: zmk-module-battery-history
      remote: cormoran
      revision: main
    - name: zmk-module-settings-rpc
      remote: cormoran
      revision: zmk-v0.3.0.0
    - name: zmk-module-runtime-input-processor
      remote: cormoran
      revision: zmk-v0.3.0.0
    - name: zmk-behavior-runtime-sensor-rotate
      remote: cormoran
      revision: zmk-v0.3.0.0
    # レイヤーガイド(画面表示)用
    - name: zmk-raw-hid
      remote: zzeneg
      revision: 6a37765dfab6197292e7a9f47305dcf87386d56a
    - name: zmk-keypeek-layer-notifier
      remote: srwi
      revision: b600af3bb7d1795073a4ce23e08d6db46371551b
  self:
    path: config
```

## dts/bindings/zmk,behavior-frost-drag-lock.yaml
```yaml
description: ドラッグ固定(押すと左クリックを押しっぱなし、もう一度で離す)
compatible: "zmk,behavior-frost-drag-lock"
include: zero_param.yaml
```

## dts/bindings/zmk,input-processor-aml-gate.yaml
```yaml
description: マウスモードでないとき、ボールがはっきり転がるまで動きを捨てる(マウスモードへの誤復帰を防ぐ)

compatible: "zmk,input-processor-aml-gate"

include: ip_zero_param.yaml

properties:
  layer:
    type: int
    default: 4
    description: マウスモードのレイヤー番号
  threshold:
    type: int
    default: 60
    description: マウスモードに入るのに必要な移動量(センサーのカウント。1500CPIで約60=1mm)
  window-ms:
    type: int
    default: 250
    description: この時間ボールが止まると、たまった移動量をリセットする
```

## dts/bindings/zmk,input-processor-scroll-snap.yaml
```yaml
description: スクロールを縦か横のどちらか一方に固定する(動かし始めの向きで決め、手を止めるまで維持)

compatible: "zmk,input-processor-scroll-snap"

include: ip_zero_param.yaml

properties:
  lock-threshold:
    type: int
    default: 4
    description: 向きを決めるまでに必要な移動量
  release-ms:
    type: int
    default: 200
    description: この時間ボールが止まると向きの固定を解除する
  ratio-percent:
    type: int
    default: 150
    description: 横の動きが縦のこの割合(%)を超えたら横スクロールと判定する(縦を優先)
```
